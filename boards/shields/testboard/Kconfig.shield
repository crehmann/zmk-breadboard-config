## boards/shields/testboard/Kconfig.shield
```kconfig
# Copyright (c) 2020 The ZMK Contributors
# SPDX-License-Identifier: MIT

config SHIELD_TESTBOARD
	def_bool $(shields_list_contains,testboard)
```
